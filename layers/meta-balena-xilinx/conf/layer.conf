## layers/meta-balena-xilinx/conf/layer.conf
```bitbake
BBPATH .= ":${LAYERDIR}"

BBFILES += "${LAYERDIR}/recipes-*/*/*.bb \
            ${LAYERDIR}/recipes-*/*/*.bbappend"

BBFILE_COLLECTIONS += "zedboard-zynq7"
BBFILE_PATTERN_zedboard-zynq7 := "^${LAYERDIR}/"
BBFILE_PRIORITY_zedboard-zynq7 = "1337"
LAYERSERIES_COMPAT_zedboard-zynq7 = "warrior"

BBFILE_COLLECTIONS += "qemu-zynq7"
BBFILE_PATTERN_qemu-zynq7 := "^${LAYERDIR}/"
BBFILE_PRIORITY_qemu-zynq7 = "1337"
LAYERSERIES_COMPAT_qemu-zynq7 = "warrior"

DISTRO_FEATURES_append += " systemd"

# PATCHES
# is BALENA_STORAGE definition trully needed?
# for some reason the do_kernel_resin_aufs_fetch_and_unpack shows an error when uses
# python-variable:balena_storage -> Exception: TypeError: must be str, not NoneType
BALENA_STORAGE = "overlay2"
```
